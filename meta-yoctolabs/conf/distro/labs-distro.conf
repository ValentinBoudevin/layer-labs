## meta-yoctolabs/conf/distro/labs-distro.conf
```bitbake
require conf/distro/poky.conf

DISTRO_NAME = "My Super Custom Distro"
DISTRO_VERSION = "1.0.0"

DISTRO_FEATURES:append = " rauc"

DISTRO_FEATURES:append = " systemd"
DISTRO_FEATURES_BACKFILL_CONSIDERED += "sysvinit"
VIRTUAL-RUNTIME_init_manager = "systemd"
VIRTUAL-RUNTIME_initscripts = "systemd-compat-units"
INIT_MANAGER = "systemd"
```

## meta-yoctolabs/conf/machine/yoctolabs.conf
```bitbake
require conf/machine/include/ti-soc.inc
SOC_FAMILY:append = ":ti33x"

DEFAULTTUNE = "armv7athf-neon"
require conf/machine/include/arm/armv7a/tune-cortexa8.inc

PREFERRED_PROVIDER_virtual/kernel = "linux-bb.org"
PREFERRED_PROVIDER_virtual/bootloader = "u-boot-bb.org"

MACHINEOVERRIDES =. "beagle.yoctolabs:"

KERNEL_DEVICETREE = " \
   am335x-boneblack.dtb \
   am335x-boneblack-wireless.dtb \
"

KERNEL_IMAGETYPE = "zImage"

UBOOT_ARCH = "arm"
UBOOT_MACHINE = "am335x_evm_config"
UBOOT_ENTRYPOINT = "0x80008000"
UBOOT_LOADADDRESS = "0x80008000"
UBOOT_IMAGE_TYPE = "zImage"
SERIAL_CONSOLES = "115200;ttyS0"
MACHINE_FEATURES += "apm usbgadget usbhost vfat ext2 alsa"

UBOOT_EXTLINUX = "1"
UBOOT_EXTLINUX_ROOT = "root=PARTUUID=${uuid}"
UBOOT_EXTLINUX_KERNEL_ARGS = "rootwait rw earlycon"
UBOOT_EXTLINUX_BOOT_FILES = " \
   extlinux.conf;extlinux/extlinux.conf \
   ${KERNEL_IMAGETYPE} \
   ${KERNEL_DEVICETREE} \
"
SPL_BINARY = "MLO"
UBOOT_SUFFIX = "img"

WKS_FILE ?= "sdimage-2part.wks"
IMAGE_BOOT_FILES ?= "${SPL_BINARY} u-boot.${UBOOT_SUFFIX} ${UBOOT_EXTLINUX_BOOT_FILES}"
IMAGE_FSTYPES += "tar.xz wic wic.xz wic.bmap"
do_image_wic[depends] += "virtual/bootloader:do_deploy"
```
